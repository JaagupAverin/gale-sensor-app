## build_qemu/Kconfig/Kconfig.modules
```kconfig
menu "hal_espressif (/home/jaagup/projects/gale/modules/hal/espressif)"
osource "/home/jaagup/projects/gale/modules/hal/espressif/zephyr/Kconfig"
config ZEPHYR_HAL_ESPRESSIF_MODULE
	bool
	default y

config ZEPHYR_HAL_ESPRESSIF_MODULE_BLOBS
	bool
endmenu
```

## build_qemu/Kconfig/arch/Kconfig
```kconfig
# Load Zephyr Arch Kconfig descriptions.
osource "/home/jaagup/projects/gale/zephyr/arch/x86/Kconfig"
osource "/home/jaagup/projects/gale/zephyr/arch/xtensa/Kconfig"
osource "/home/jaagup/projects/gale/zephyr/arch/sparc/Kconfig"
osource "/home/jaagup/projects/gale/zephyr/arch/riscv/Kconfig"
osource "/home/jaagup/projects/gale/zephyr/arch/posix/Kconfig"
osource "/home/jaagup/projects/gale/zephyr/arch/nios2/Kconfig"
osource "/home/jaagup/projects/gale/zephyr/arch/mips/Kconfig"
osource "/home/jaagup/projects/gale/zephyr/arch/arm64/Kconfig"
osource "/home/jaagup/projects/gale/zephyr/arch/arm/Kconfig"
osource "/home/jaagup/projects/gale/zephyr/arch/arc/Kconfig"
```

## build_qemu/Kconfig/boards/Kconfig
```kconfig
# Load Zephyr board Kconfig descriptions.
osource "/home/jaagup/projects/gale/zephyr/boards/qemu/riscv32/Kconfig"
```

## build_qemu/Kconfig/boards/Kconfig.defconfig
```kconfig
# Load Zephyr board defconfig descriptions.
osource "/home/jaagup/projects/gale/zephyr/boards/qemu/riscv32/Kconfig.defconfig"
```

## build_qemu/Kconfig/boards/Kconfig.qemu_riscv32
```kconfig
# Load board Kconfig descriptions.
osource "/home/jaagup/projects/gale/zephyr/boards/qemu/riscv32/Kconfig.qemu_riscv32"
```

## build_qemu/Kconfig/boards/Kconfig.sysbuild
```kconfig
# Load Sysbuild board Kconfig descriptions.
osource "/home/jaagup/projects/gale/zephyr/boards/qemu/riscv32/Kconfig.sysbuild"
```

## build_qemu/Kconfig/soc/Kconfig
```kconfig
# Load Zephyr SoC Kconfig descriptions.
osource "/home/jaagup/projects/gale/zephyr/soc/xlnx/zynqmp/Kconfig"
osource "/home/jaagup/projects/gale/zephyr/soc/xlnx/zynq7000/Kconfig"
osource "/home/jaagup/projects/gale/zephyr/soc/xlnx/versalnet/Kconfig"
osource "/home/jaagup/projects/gale/zephyr/soc/xen/Kconfig"
osource "/home/jaagup/projects/gale/zephyr/soc/wch/ch32v/Kconfig"
osource "/home/jaagup/projects/gale/zephyr/soc/ti/simplelink/Kconfig"
osource "/home/jaagup/projects/gale/zephyr/soc/ti/lm3s6965/Kconfig"
osource "/home/jaagup/projects/gale/zephyr/soc/ti/k3/Kconfig"
osource "/home/jaagup/projects/gale/zephyr/soc/telink/tlsr/Kconfig"
osource "/home/jaagup/projects/gale/zephyr/soc/starfive/jh71xx/Kconfig"
osource "/home/jaagup/projects/gale/zephyr/soc/st/stm32/Kconfig"
osource "/home/jaagup/projects/gale/zephyr/soc/snps/qemu_arc/Kconfig"
osource "/home/jaagup/projects/gale/zephyr/soc/snps/nsim/arc_v/Kconfig"
osource "/home/jaagup/projects/gale/zephyr/soc/snps/nsim/arc_classic/Kconfig"
osource "/home/jaagup/projects/gale/zephyr/soc/snps/hsdk4xd/Kconfig"
osource "/home/jaagup/projects/gale/zephyr/soc/snps/hsdk/Kconfig"
osource "/home/jaagup/projects/gale/zephyr/soc/snps/emsk/Kconfig"
osource "/home/jaagup/projects/gale/zephyr/soc/snps/emsdp/Kconfig"
osource "/home/jaagup/projects/gale/zephyr/soc/snps/arc_iot/Kconfig"
osource "/home/jaagup/projects/gale/zephyr/soc/silabs/Kconfig"
osource "/home/jaagup/projects/gale/zephyr/soc/sifive/sifive_freedom/Kconfig"
osource "/home/jaagup/projects/gale/zephyr/soc/sensry/Kconfig"
osource "/home/jaagup/projects/gale/zephyr/soc/rockchip/Kconfig"
osource "/home/jaagup/projects/gale/zephyr/soc/renode/riscv_virtual/Kconfig"
osource "/home/jaagup/projects/gale/zephyr/soc/renode/cortex_r8_virtual/Kconfig"
osource "/home/jaagup/projects/gale/zephyr/soc/renesas/smartbond/Kconfig"
osource "/home/jaagup/projects/gale/zephyr/soc/renesas/rz/Kconfig"
osource "/home/jaagup/projects/gale/zephyr/soc/renesas/rcar/Kconfig"
osource "/home/jaagup/projects/gale/zephyr/soc/renesas/ra/Kconfig"
osource "/home/jaagup/projects/gale/zephyr/soc/realtek/ec/Kconfig"
osource "/home/jaagup/projects/gale/zephyr/soc/raspberrypi/rpi_pico/Kconfig"
osource "/home/jaagup/projects/gale/zephyr/soc/quicklogic/eos_s3/Kconfig"
osource "/home/jaagup/projects/gale/zephyr/soc/qemu/virt_riscv/Kconfig"
osource "/home/jaagup/projects/gale/zephyr/soc/qemu/malta/Kconfig"
osource "/home/jaagup/projects/gale/zephyr/soc/openisa/rv32m1/Kconfig"
osource "/home/jaagup/projects/gale/zephyr/soc/oct/osd32mp15x/Kconfig"
osource "/home/jaagup/projects/gale/zephyr/soc/nxp/s32/Kconfig"
osource "/home/jaagup/projects/gale/zephyr/soc/nxp/rw/Kconfig"
osource "/home/jaagup/projects/gale/zephyr/soc/nxp/mcx/Kconfig"
osource "/home/jaagup/projects/gale/zephyr/soc/nxp/lpc/Kconfig"
osource "/home/jaagup/projects/gale/zephyr/soc/nxp/layerscape/Kconfig"
osource "/home/jaagup/projects/gale/zephyr/soc/nxp/kinetis/Kconfig"
osource "/home/jaagup/projects/gale/zephyr/soc/nxp/imxrt/Kconfig"
osource "/home/jaagup/projects/gale/zephyr/soc/nxp/imx/Kconfig"
osource "/home/jaagup/projects/gale/zephyr/soc/nuvoton/numicro/Kconfig"
osource "/home/jaagup/projects/gale/zephyr/soc/nuvoton/numaker/Kconfig"
osource "/home/jaagup/projects/gale/zephyr/soc/nuvoton/npcx/Kconfig"
osource "/home/jaagup/projects/gale/zephyr/soc/nuvoton/npcm/Kconfig"
osource "/home/jaagup/projects/gale/zephyr/soc/nordic/Kconfig"
osource "/home/jaagup/projects/gale/zephyr/soc/neorv32/Kconfig"
osource "/home/jaagup/projects/gale/zephyr/soc/native/inf_clock/Kconfig"
osource "/home/jaagup/projects/gale/zephyr/soc/microchip/miv/Kconfig"
osource "/home/jaagup/projects/gale/zephyr/soc/microchip/mec/Kconfig"
osource "/home/jaagup/projects/gale/zephyr/soc/mediatek/mt8xxx/Kconfig"
osource "/home/jaagup/projects/gale/zephyr/soc/lowrisc/opentitan/Kconfig"
osource "/home/jaagup/projects/gale/zephyr/soc/litex/litex_vexriscv/Kconfig"
osource "/home/jaagup/projects/gale/zephyr/soc/ite/ec/Kconfig"
osource "/home/jaagup/projects/gale/zephyr/soc/intel/raptor_lake/Kconfig"
osource "/home/jaagup/projects/gale/zephyr/soc/intel/lakemont/Kconfig"
osource "/home/jaagup/projects/gale/zephyr/soc/intel/intel_socfpga_std/Kconfig"
osource "/home/jaagup/projects/gale/zephyr/soc/intel/intel_socfpga/Kconfig"
osource "/home/jaagup/projects/gale/zephyr/soc/intel/intel_niosv/Kconfig"
osource "/home/jaagup/projects/gale/zephyr/soc/intel/intel_ish/Kconfig"
osource "/home/jaagup/projects/gale/zephyr/soc/intel/intel_adsp/Kconfig"
osource "/home/jaagup/projects/gale/zephyr/soc/intel/elkhart_lake/Kconfig"
osource "/home/jaagup/projects/gale/zephyr/soc/intel/atom/Kconfig"
osource "/home/jaagup/projects/gale/zephyr/soc/intel/apollo_lake/Kconfig"
osource "/home/jaagup/projects/gale/zephyr/soc/intel/alder_lake/Kconfig"
osource "/home/jaagup/projects/gale/zephyr/soc/infineon/cat3/Kconfig"
osource "/home/jaagup/projects/gale/zephyr/soc/infineon/cat1b/Kconfig"
osource "/home/jaagup/projects/gale/zephyr/soc/infineon/cat1a/Kconfig"
osource "/home/jaagup/projects/gale/zephyr/soc/gd/gd32/Kconfig"
osource "/home/jaagup/projects/gale/zephyr/soc/gaisler/leon3/Kconfig"
osource "/home/jaagup/projects/gale/zephyr/soc/gaisler/gr716a/Kconfig"
osource "/home/jaagup/projects/gale/zephyr/soc/espressif/Kconfig"
osource "/home/jaagup/projects/gale/zephyr/soc/ene/kb1200/Kconfig"
osource "/home/jaagup/projects/gale/zephyr/soc/efinix/sapphire/Kconfig"
osource "/home/jaagup/projects/gale/zephyr/soc/cdns/xtensa_sample_controller/Kconfig"
osource "/home/jaagup/projects/gale/zephyr/soc/cdns/sample_controller32/Kconfig"
osource "/home/jaagup/projects/gale/zephyr/soc/cdns/dc233c/Kconfig"
osource "/home/jaagup/projects/gale/zephyr/soc/brcm/bcmvk/Kconfig"
osource "/home/jaagup/projects/gale/zephyr/soc/brcm/bcm2712/Kconfig"
osource "/home/jaagup/projects/gale/zephyr/soc/brcm/bcm2711/Kconfig"
osource "/home/jaagup/projects/gale/zephyr/soc/atmel/sam0/Kconfig"
osource "/home/jaagup/projects/gale/zephyr/soc/atmel/sam/Kconfig"
osource "/home/jaagup/projects/gale/zephyr/soc/aspeed/Kconfig"
osource "/home/jaagup/projects/gale/zephyr/soc/arm/Kconfig"
osource "/home/jaagup/projects/gale/zephyr/soc/arm/beetle/Kconfig"
osource "/home/jaagup/projects/gale/zephyr/soc/antmicro/myra/Kconfig"
osource "/home/jaagup/projects/gale/zephyr/soc/andestech/Kconfig"
osource "/home/jaagup/projects/gale/zephyr/soc/amd/acp_6_0/Kconfig"
osource "/home/jaagup/projects/gale/zephyr/soc/ambiq/Kconfig"
osource "/home/jaagup/projects/gale/zephyr/soc/altr/zephyr_nios2f/Kconfig"
osource "/home/jaagup/projects/gale/zephyr/soc/altr/qemu_nios2/Kconfig"
osource "/home/jaagup/projects/gale/zephyr/soc/adi/max32/Kconfig"
```
