## CMakeLists.txt
```
cmake_minimum_required(VERSION 3.10)

project(gale_sensor_app)

# TODO: Actually build a Zephyr thingy.
```

## west.yml
```
manifest:
  version: "1.2"

  self:
    path: gale_sensor_app

  remotes:
    - name: origin
      url-base: https://github.com/JaagupAverin

  projects:
    - name: gale-shared
      path: gale_shared
      remote: origin
      revision: main
      import: true
```

## prj.conf
```kconfig
CONFIG_LOG=y
CONFIG_LOG_BACKEND_UART=y
CONFIG_LOG_MODE_DEFERRED=y
CONFIG_LOG_BUFFER_SIZE=4096

# =============================================================================
# Shell:

# Basics:
CONFIG_SHELL=y
CONFIG_SHELL_TAB=y
CONFIG_SHELL_CMDS=y
CONFIG_SHELL_HISTORY=y

# Backends:
CONFIG_SHELL_LOG_BACKEND=y
CONFIG_SHELL_BACKEND_SERIAL=n

# Shell features:
CONFIG_KERNEL_SHELL=y
CONFIG_DEVICE_SHELL=y

# =============================================================================
# QEMU (TODO: Move elsewhere)

CONFIG_QEMU_ICOUNT=n
```

## src/main.cpp
```c
#include <zephyr/kernel.h>
#include <zephyr/logging/log.h>

LOG_MODULE_REGISTER(main, LOG_LEVEL_DBG);

int main() {
  while (true) {
    LOG_INF("Hello from sensor.");
    k_sleep(K_MSEC(1000));
  }
  return 0;
}
```
